## config/west.yml
```yaml
manifest:
  remotes:
    - name: moergo-sc
      url-base: https://github.com/moergo-sc
  projects:
    - name: zmk
      remote: moergo-sc
      revision: zephyr-4-1
      import: app/west.yml
  self:
    path: config
```
